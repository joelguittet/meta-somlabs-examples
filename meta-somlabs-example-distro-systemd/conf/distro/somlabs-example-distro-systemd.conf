## meta-somlabs-example-distro-systemd/conf/distro/somlabs-example-distro-systemd.conf
```bitbake
DISTRO = "somlabs-example-distro-systemd"
DISTROOVERRIDES = "poky"
DISTRO_NAME = "SoMLabs example distro systemd"

require conf/distro/poky.conf

# Use systemd exclusively
DISTRO_FEATURES_append = " systemd"
VIRTUAL-RUNTIME_init_manager = "systemd"
VIRTUAL-RUNTIME_dev_manager = "systemd"

# Prevent the SysVinit distribution feature from being automatically enabled
DISTRO_FEATURES_BACKFILL_CONSIDERED = "sysvinit"

# Remove any redundant SysVinit scripts
VIRTUAL-RUNTIME_initscripts = ""

# Systemd - enable networkd
PACKAGECONFIG_append_pn-systemd = " networkd"
```

## meta-somlabs-example-distro-systemd/conf/layer.conf
```bitbake
# We have a conf and classes directory, add to BBPATH
BBPATH .= ":${LAYERDIR}"

# We have recipes-* directories, add to BBFILES
BBFILES += "${LAYERDIR}/recipes-*/*/*.bb \
    ${LAYERDIR}/recipes-*/*/*.bbappend"

BBFILE_COLLECTIONS += "somlabs-example-distro-systemd"
BBFILE_PATTERN_somlabs-example-distro-systemd = "^${LAYERDIR}/"
BBFILE_PRIORITY_somlabs-example-distro-systemd = "12"

LAYERSERIES_COMPAT_somlabs-example-distro-systemd =  "warrior"
```

## meta-somlabs-example-visioncb-6ull-std/conf/layer.conf
```bitbake
# We have a conf and classes directory, add to BBPATH
BBPATH .= ":${LAYERDIR}"

# We have recipes-* directories, add to BBFILES
BBFILES += "${LAYERDIR}/recipes-*/*/*.bb \
    ${LAYERDIR}/recipes-*/*/*.bbappend"

BBFILE_COLLECTIONS += "somlabs-example-visioncb-6ull-std"
BBFILE_PATTERN_somlabs-example-visioncb-6ull-std = "^${LAYERDIR}/"
BBFILE_PRIORITY_somlabs-example-visioncb-6ull-std = "12"

LAYERSERIES_COMPAT_somlabs-example-visioncb-6ull-std =  "warrior"
```
