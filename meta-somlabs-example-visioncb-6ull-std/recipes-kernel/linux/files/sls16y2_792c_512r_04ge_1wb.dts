/*
 * This program is free software; you can redistribute it and/or modify
 * it under the terms of the GNU General Public License version 2 as
 * published by the Free Software Foundation.
 */

/dts-v1/;

#include "sls16xx-base.dtsi"
#include "sls16xx-emmc.dtsi"
#include "sls16xx-bluetooth-murata-1dx.dtsi"
#include "sls16xx-wifi-murata-1dx.dtsi"
#include "visioncb-6ull-std-v2-ethernet-1.dtsi"
#include "visioncb-6ull-std-v2-i2c-2.dtsi"
#include "visioncb-6ull-std-v2-lcd.dtsi"
#include "visioncb-6ull-std-v2-spi-3.dtsi"
#include "visioncb-6ull-std-v2-uart-4.dtsi"
#include "visioncb-6ull-std-v2-usb-1-otg.dtsi"
#include "visioncb-6ull-std-v2-usb-2-host.dtsi"

/ {
	model = "SoMLabs VisionSOM-6ULL-STD v2 + SLS16Y2_792C_512R_04GE_1WB";
};
