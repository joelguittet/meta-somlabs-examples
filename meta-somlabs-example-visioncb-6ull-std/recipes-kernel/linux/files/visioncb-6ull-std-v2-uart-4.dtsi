/*
 * This program is free software; you can redistribute it and/or modify
 * it under the terms of the GNU General Public License version 2 as
 * published by the Free Software Foundation.
 */

/* IO multiplexing */
&iomuxc {
	/* UART4 */
	pinctrl_uart4: uart4 {
		fsl,pins = <
			MX6UL_PAD_UART4_TX_DATA__UART4_DCE_TX 0x1b0b1
			MX6UL_PAD_UART4_RX_DATA__UART4_DCE_RX 0x1b0b1
		>;
	};
};

/* UART4 */
&uart4 {
	pinctrl-names = "default";
	pinctrl-0 = <&pinctrl_uart4>;
	status = "okay";
};
